## package/python-firmtool/Config.in
```kconfig
config BR2_PACKAGE_PYTHON_FIRMTOOL
	bool "python-firmtool"
	select BR2_PACKAGE_PYTHON_PYCRYPTODOME
	select BR2_PACKAGE_PYTHON3
	help
	  A tool to parse, extract, and build 3DS firmware files.
	  https://github.com/TuxSH/firmtool
```

## package/python-firmtool/Config.in.host
```kconfig
config BR2_PACKAGE_HOST_PYTHON_FIRMTOOL
	bool "host python-firmtool"
	select BR2_PACKAGE_HOST_PYTHON_PYCRYPTODOME
	select BR2_PACKAGE_HOST_PYTHON3
	help
	  A tool to parse, extract, and build 3DS firmware files.
	  https://github.com/TuxSH/firmtool
```

## package/python-pycryptodome/Config.in
```kconfig
config BR2_PACKAGE_PYTHON_PYCRYPTODOME
	bool "python-pycryptodome"
	select BR2_PACKAGE_PYTHON3
	help
	  Cryptographic library for Python.

	  https://www.pycryptodome.org
```

## package/python-pycryptodome/Config.in.host
```kconfig
config BR2_PACKAGE_HOST_PYTHON_PYCRYPTODOME
	bool "host python-pycryptodome"
	select BR2_PACKAGE_HOST_PYTHON3
	help
	  Cryptographic library for Python.

	  https://www.pycryptodome.org
```
